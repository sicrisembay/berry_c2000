## applications/console_uart/Kconfig
```kconfig
mainmenu "Console Uart"

config BERRY_STARTUP_DIAGNOSTICS
	bool "Run Berry C28 startup diagnostics"
	default n

rsource ../../components/drivers/Kconfig
```

## applications/console_uart/configs/defconfig
```kconfig
#
# Drivers
#
# CONFIG_BERRY_STARTUP_DIAGNOSTICS is not set

#
# Core
#
# CONFIG_CRYSTAL_20MHZ is not set
CONFIG_CRYSTAL_30MHZ=y
CONFIG_CORE_FREQ_150MHZ=y
# end of Core

CONFIG_SYSTEM_FREQ_MHZ=150
CONFIG_USE_UART=y
CONFIG_ENABLE_UARTA=y
CONFIG_UARTA_TX_GPIO29=y
# CONFIG_UARTA_TX_GPIO35 is not set
CONFIG_UARTA_TX_GPIO=29
CONFIG_UARTA_RX_GPIO28=y
# CONFIG_UARTA_RX_GPIO36 is not set
CONFIG_UARTA_RX_GPIO=28
CONFIG_BAUDRATE_UARTA=115200
CONFIG_TX_QUEUE_BUFF_SZ_UARTA=512
CONFIG_RX_QUEUE_BUFF_SZ_UARTA=512
# CONFIG_ENABLE_UARTB is not set
# CONFIG_ENABLE_UARTC is not set
# end of Drivers
```

## components/drivers/Kconfig
```kconfig
menu "Drivers"
    rsource "./board/Kconfig"
    rsource "./uart/Kconfig"
endmenu
```
